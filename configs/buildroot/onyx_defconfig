## configs/buildroot/onyx_defconfig
```kconfig
# ============================================================================
# ONYX-GATE Pre-Boot Authentication (PBA) - Buildroot Configuration
# ============================================================================
#
# This configuration builds a minimal Linux system that boots from Shadow MBR
# and runs the ONYX-GATE PBA application for drive authentication.
#
# Current Status: Hello World MVP - displays PBA interface and waits for input
# Future Goal: Full FIDO2 + TCG OPAL authentication system
#
# Build Output: ~12MB bootable ISO containing Linux + PBA application
# Target Hardware: x86_64 systems with TCG OPAL 2.0 drives
#
# ============================================================================

# ----------------------------------------------------------------------------
# TARGET ARCHITECTURE
# ----------------------------------------------------------------------------
# We target modern x86_64 systems (Intel/AMD 64-bit processors)
# This ensures compatibility with most desktop/laptop hardware where
# TCG OPAL self-encrypting drives are commonly deployed
BR2_x86_64=y
BR2_x86_generic=y

# ----------------------------------------------------------------------------
# SYSTEM IDENTITY & CONSOLE
# ----------------------------------------------------------------------------
# The PBA system identifies itself and provides console access
# This is what users see when the system boots
BR2_SYSTEM_HOSTNAME="onyx-gate-pba"
BR2_SYSTEM_BANNER="🖤 ONYX-GATE PBA - The elegant gateway to unbreakable security"
BR2_TARGET_GENERIC_GETTY_PORT="console"
BR2_TARGET_GENERIC_GETTY_BAUDRATE_115200=y

# ----------------------------------------------------------------------------
# INIT SYSTEM & DEVICE MANAGEMENT
# ----------------------------------------------------------------------------
# BusyBox provides a lightweight init system that starts our PBA application
# Dynamic devtmpfs creates device nodes automatically (no static device table)
BR2_INIT_BUSYBOX=y
BR2_ROOTFS_DEVICE_CREATION_DYNAMIC_DEVTMPFS=y

# ----------------------------------------------------------------------------
# ROOT FILESYSTEM CONFIGURATION
# ----------------------------------------------------------------------------
# Shadow MBR has limited space (~32MB), so we use a small, efficient filesystem
# EXT2/4 provides reliability and is well-supported by bootloaders
BR2_TARGET_ROOTFS_EXT2=y
BR2_TARGET_ROOTFS_EXT2_4=y
BR2_TARGET_ROOTFS_EXT2_SIZE="30M"  # Compact size for Shadow MBR deployment

# CPIO creates an initramfs (RAM-based filesystem) for fast boot
# This allows the entire PBA system to run from memory
BR2_TARGET_ROOTFS_CPIO=y
BR2_TARGET_ROOTFS_CPIO_GZIP=y

# ISO9660 creates a bootable CD image for testing in VMs
BR2_TARGET_ROOTFS_ISO9660=y

# ----------------------------------------------------------------------------
# LINUX KERNEL
# ----------------------------------------------------------------------------
# We use the latest stable kernel for maximum hardware compatibility
# bzImage format is required for x86_64 GRUB booting
BR2_LINUX_KERNEL=y
BR2_LINUX_KERNEL_LATEST_VERSION=y
BR2_LINUX_KERNEL_USE_DEFCONFIG=y
BR2_LINUX_KERNEL_DEFCONFIG="x86_64"
BR2_LINUX_KERNEL_BZIMAGE=y

# ----------------------------------------------------------------------------
# BOOTLOADER
# ----------------------------------------------------------------------------
# GRUB2 provides UEFI and BIOS compatibility for maximum hardware support
# Essential for booting from Shadow MBR on various systems
BR2_TARGET_GRUB2=y
BR2_TARGET_GRUB2_I386_PC=y

# ----------------------------------------------------------------------------
# ESSENTIAL PACKAGES (CURRENTLY ACTIVE)
# ----------------------------------------------------------------------------
# BusyBox provides core Unix utilities (init, shell, basic commands)
# This is the absolute minimum needed to run our PBA application
BR2_PACKAGE_BUSYBOX=y
BR2_PACKAGE_BUSYBOX_SHOW_OTHERS=y

# ============================================================================
# FUTURE FEATURES (CURRENTLY DISABLED)
# ============================================================================
# These packages are commented out to keep the current build minimal.
# Uncomment sections as features are implemented.

# ----------------------------------------------------------------------------
# DISK & FILESYSTEM UTILITIES (Future: TCG OPAL Drive Management)
# ----------------------------------------------------------------------------
# These tools will be needed when we implement drive detection and unlocking:
# - util-linux: Advanced disk utilities (blkid, fdisk, etc.)
# - e2fsprogs: EXT2/3/4 filesystem tools
# - libblkid/libuuid: Block device identification libraries
#
# Enable when implementing: TCG OPAL drive detection and unlocking
# BR2_PACKAGE_UTIL_LINUX=y
# BR2_PACKAGE_UTIL_LINUX_LIBBLKID=y
# BR2_PACKAGE_UTIL_LINUX_LIBUUID=y
# BR2_PACKAGE_E2FSPROGS=y

# ----------------------------------------------------------------------------
# HARDWARE DETECTION (Future: Device Discovery)
# ----------------------------------------------------------------------------
# These utilities help identify and communicate with hardware:
# - pciutils: PCI device detection (for finding OPAL drives)
# - usbutils: USB device detection (for finding YubiKeys)
# - libusb: Low-level USB communication library
#
# Enable when implementing: Hardware device discovery and enumeration
# BR2_PACKAGE_PCIUTILS=y          # lspci, setpci - for OPAL SSD detection
# BR2_PACKAGE_USBUTILS=y          # lsusb, usb-devices - for FIDO2 device detection
# BR2_PACKAGE_LIBUSB=y            # USB HID communication for YubiKey

# ----------------------------------------------------------------------------
# NETWORKING (Future: Remote Authentication Features)
# ----------------------------------------------------------------------------
# Network support for advanced authentication scenarios:
# - DHCP client for automatic network configuration
#
# Enable when implementing: Network-based authentication or remote unlocking
# BR2_PACKAGE_DHCPCD=y            # DHCP client for network auto-configuration

# ----------------------------------------------------------------------------
# CRYPTOGRAPHY (Future: FIPS 140-2 Security)
# ----------------------------------------------------------------------------
# Government-grade cryptographic libraries:
# - OpenSSL: FIPS 140-2 validated cryptographic functions
# - OpenSSL binaries: Command-line crypto tools
#
# Enable when implementing: FIPS-compliant cryptography and key derivation
# BR2_PACKAGE_OPENSSL=y           # FIPS 140-2 validated crypto library
# BR2_PACKAGE_OPENSSL_BIN=y       # openssl command-line tools

# ----------------------------------------------------------------------------
# ADVANCED FILESYSTEM SUPPORT (Future: Optimization)
# ----------------------------------------------------------------------------
# Compressed filesystems for space optimization:
# - SquashFS: Read-only compressed filesystem
# - LZ4 compression: Fast compression/decompression
#
# Enable when implementing: Space-optimized deployments
# BR2_TARGET_ROOTFS_SQUASHFS=y    # Compressed read-only filesystem
# BR2_TARGET_ROOTFS_SQUASHFS4_LZ4=y  # Fast LZ4 compression algorithm

# ============================================================================
# DEVELOPMENT ROADMAP
# ============================================================================
#
# Phase 1 (Current): Hello World PBA
#   - Status: ✅ COMPLETE
#   - Features: Basic PBA interface, user input handling
#   - Size: ~12MB image
#
# Phase 2 (Next): Virtual Keyboard Anti-Keylogger
#   - Status: 🔄 PLANNED
#   - Requirements: No additional packages needed
#   - Features: Randomized virtual keyboard navigation
#
# Phase 3: FIDO2/YubiKey Authentication
#   - Status: 📋 FUTURE
#   - Requirements: Uncomment USB and crypto packages
#   - Features: Hardware-bound authentication
#
# Phase 4: TCG OPAL Drive Integration
#   - Status: 📋 FUTURE  
#   - Requirements: Uncomment disk utilities and PCI packages
#   - Features: Automatic drive detection and unlocking
#
# Phase 5: FIPS 140-2 Compliance
#   - Status: 📋 FUTURE
#   - Requirements: Uncomment OpenSSL packages
#   - Features: Government-grade cryptography
#
# ============================================================================
```

## configs/buildroot/onyx_gate_defconfig
```kconfig
# ============================================================================
# ONYX-GATE Pre-Boot Authentication System - Buildroot Configuration
# ============================================================================
#
# This defconfig builds a minimal Linux system optimized for PBA deployment
# on TCG OPAL self-encrypting drives. Uses generic x86_64 for compatibility.
#
# Target: All x86_64 processors (Intel/AMD)
# Size: ~30MB filesystem, ~3MB compressed initrd
# Boot time: <10 seconds to PBA interface
#
# ============================================================================

# ----------------------------------------------------------------------------
# TARGET ARCHITECTURE
# ----------------------------------------------------------------------------
# Generic x86_64 ensures compatibility with all processors
BR2_x86_64=y
BR2_x86_generic=y

# ----------------------------------------------------------------------------
# SYSTEM CONFIGURATION
# ----------------------------------------------------------------------------
BR2_SYSTEM_HOSTNAME="onyx-gate-pba"
BR2_SYSTEM_BANNER="🖤 ONYX-GATE PBA - The elegant gateway to unbreakable security"
BR2_TARGET_GENERIC_GETTY_PORT="console"
BR2_TARGET_GENERIC_GETTY_BAUDRATE_115200=y

# ----------------------------------------------------------------------------
# INIT SYSTEM & DEVICE MANAGEMENT
# ----------------------------------------------------------------------------
BR2_INIT_BUSYBOX=y
BR2_ROOTFS_DEVICE_CREATION_DYNAMIC_DEVTMPFS=y

# ----------------------------------------------------------------------------
# BOARD-SPECIFIC FILES
# ----------------------------------------------------------------------------
# Root filesystem overlay containing our PBA application and configs
BR2_ROOTFS_OVERLAY="board/onyx-gate/rootfs-overlay"

# ----------------------------------------------------------------------------
# FILESYSTEM IMAGES
# ----------------------------------------------------------------------------
# EXT2/4 for compatibility and reliability
BR2_TARGET_ROOTFS_EXT2=y
BR2_TARGET_ROOTFS_EXT2_4=y
BR2_TARGET_ROOTFS_EXT2_SIZE="30M"

# CPIO initrd for RAM-based boot (fast startup)
BR2_TARGET_ROOTFS_CPIO=y
BR2_TARGET_ROOTFS_CPIO_GZIP=y

# ----------------------------------------------------------------------------
# LINUX KERNEL
# ----------------------------------------------------------------------------
BR2_LINUX_KERNEL=y
BR2_LINUX_KERNEL_LATEST_VERSION=y
BR2_LINUX_KERNEL_USE_DEFCONFIG=y
BR2_LINUX_KERNEL_DEFCONFIG="x86_64"
BR2_LINUX_KERNEL_BZIMAGE=y

# Custom kernel config (when needed)
# BR2_LINUX_KERNEL_USE_CUSTOM_CONFIG=y
# BR2_LINUX_KERNEL_CUSTOM_CONFIG_FILE="board/onyx-gate/linux.config"

# ----------------------------------------------------------------------------
# ESSENTIAL PACKAGES
# ----------------------------------------------------------------------------
BR2_PACKAGE_BUSYBOX=y
BR2_PACKAGE_BUSYBOX_SHOW_OTHERS=y

# ============================================================================
# FUTURE ENHANCEMENTS (CURRENTLY DISABLED)
# ============================================================================
# Uncomment sections below as features are implemented

# ----------------------------------------------------------------------------
# DISK UTILITIES (Future: TCG OPAL Drive Management)
# ----------------------------------------------------------------------------
# BR2_PACKAGE_UTIL_LINUX=y
# BR2_PACKAGE_UTIL_LINUX_LIBBLKID=y
# BR2_PACKAGE_E2FSPROGS=y

# ----------------------------------------------------------------------------
# USB/HID SUPPORT (Future: FIDO2 YubiKey)
# ----------------------------------------------------------------------------
# BR2_PACKAGE_LIBUSB=y
# BR2_PACKAGE_USBUTILS=y

# ----------------------------------------------------------------------------
# CRYPTOGRAPHY (Future: FIPS 140-3 Support)
# ----------------------------------------------------------------------------
# BR2_PACKAGE_OPENSSL=y
# BR2_PACKAGE_OPENSSL_BIN=y

# ----------------------------------------------------------------------------
# NETWORKING (Future: Remote Authentication)
# ----------------------------------------------------------------------------
# BR2_PACKAGE_DHCPCD=y
```
